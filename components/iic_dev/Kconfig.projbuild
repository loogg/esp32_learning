## components/iic_dev/Kconfig.projbuild
```kconfig
menu "IIC DEV Configuration"

    config IIC_DEV_PIN_SCL
        int "IIC SCL Pin"
        default 42

    config IIC_DEV_PIN_SDA
        int "IIC SDA Pin"
        default 41

endmenu
```

## components/spi_dev/Kconfig.projbuild
```kconfig
menu "SPI DEV Configuration"

    config SPI_DEV_PIN_MOSI
        int "SPI MOSI Pin"
        default 11

    config SPI_DEV_PIN_MISO
        int "SPI MISO Pin"
        default 13

    config SPI_DEV_PIN_SCK
        int "SPI SCK Pin"
        default 12

    config SPI_DEV_PIN_SD_CS
        int "SPI SD Card CS Pin"
        default 2

    config SPI_DEV_PIN_LCD_CS
        int "SPI LCD CS Pin"
        default 21

endmenu
```

## components/spisdcard/Kconfig.projbuild
```kconfig
menu "SD Card Configuration"

    config SDCARD_DETECT
        bool "Enable SD Card Detection"
        default n
        help
            Enable detection of SD card insertion and removal.

    if SDCARD_DETECT

        config SDCARD_DETECT_GPIO
            int "GPIO Pin for SD Card Detection"
            default 8
            help
                Specify the GPIO pin number used for detecting SD card insertion.

    endif

endmenu
```

## main/Kconfig.projbuild
```kconfig
menu "Example Configuration"

    choice "USB Adapter"
        prompt "Select USB Adapter"
        default USB_ADAPTER_CHERRYUSB

        config USB_ADAPTER_CHERRYUSB
            bool "CherryUSB"
            help
                Select CherryUSB USB Adapter.

        config USB_ADAPTER_IDF_USB
            bool "ESP-IDF USB"
            help
                Select ESP-IDF USB Adapter.
    endchoice

    choice "Console Adapter"
        prompt "Select Console Adapter"
        default CONSOLE_ADAPTER_LETTER_SHELL

        config CONSOLE_ADAPTER_LETTER_SHELL
            bool "Letter Shell"
            help
                Select Letter Shell Console Adapter.

        config CONSOLE_ADAPTER_ESP_CONSOLE
            bool "ESP Console"
            help
                Select ESP Console Adapter.
    endchoice

    choice "font ttf type"
        prompt "Select font ttf type"
        default FONT_TTF_USING_TINYTTF

        config FONT_TTF_USING_TINYTTF
            bool "tinyttf"
            help
                Select tinyttf font type.
    endchoice

endmenu
```
